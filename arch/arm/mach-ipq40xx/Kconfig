## arch/arm/mach-ipq40xx/Kconfig
```kconfig
if ARCH_IPQ40XX

config SYS_SOC
	default "ipq40xx"

config SYS_MALLOC_F_LEN
	default 0x2000

config TEXT_BASE
	default 0x87300000

config NR_DRAM_BANKS
	default 1

choice
	prompt "IPQ40xx board select"
	optional

config TARGET_SENAO_EAP1300
	bool "Support Senao EAP1300 board"

endchoice

source "board/senao/eap1300/Kconfig"

endif
```

## board/senao/eap1300/Kconfig
```kconfig
if TARGET_SENAO_EAP1300

config SYS_BOARD
	default "eap1300"

config SYS_VENDOR
	default "senao"

config SYS_CONFIG_NAME
	default "senao-eap1300"

endif
```

## configs/senao_eap1300_defconfig
```kconfig
CONFIG_ARM=y
CONFIG_ARCH_IPQ40XX=y
CONFIG_TARGET_SENAO_EAP1300=y
CONFIG_POSITION_INDEPENDENT=y
CONFIG_SYS_LOAD_ADDR=0x87300000
CONFIG_SYS_ARCH_TIMER=y

CONFIG_POWER_DOMAIN=y
CONFIG_DRIVER_GICV2=y

CONFIG_SYSRESET=y
CONFIG_SYSRESET_QCOM_PSHOLD=y

CONFIG_DEBUG_UART=y
CONFIG_DEBUG_UART_MSM=y
CONFIG_DEBUG_UART_BASE=0x78af000
CONFIG_DEBUG_UART_CLOCK=1843200
CONFIG_DEBUG_UART_SKIP_INIT=y

CONFIG_MSM_GPIO=y

CONFIG_MSM_SERIAL=y

CONFIG_SPI=y
CONFIG_DM_SPI=y
CONFIG_SPI_QUP=y

CONFIG_MTD=y
CONFIG_DM_MTD=y
CONFIG_DM_SPI_FLASH=y
CONFIG_SPI_FLASH_SFDP_SUPPORT=y
CONFIG_SPI_FLASH_WINBOND=y
CONFIG_SPI_FLASH_MTD=y

CONFIG_PHYLIB=y
CONFIG_DM_MDIO=y
CONFIG_DM_ETH_PHY=y
CONFIG_MDIO_IPQ4019=y

CONFIG_BUTTON=y
CONFIG_BUTTON_GPIO=y

CONFIG_LED=y
CONFIG_LED_GPIO=y

CONFIG_OF_UPSTREAM=n
CONFIG_DEFAULT_DEVICE_TREE="senao_eap1300"

CONFIG_LOG=y
CONFIG_EFI_LOADER=n
CONFIG_FIT=y
```
